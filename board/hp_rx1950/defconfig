## buildroot/external/rx1950/Config.in
```kconfig
menu "rx1950 Linux configuration"

comment "HP iPAQ rx1950 target"

source "$BR2_EXTERNAL_RX1950_PATH/package/jwm/Config.in"

endmenu
```

## buildroot/external/rx1950/configs/rx1950_defconfig
```kconfig
BR2_arm=y
BR2_arm920t=y
BR2_ARM_EABI=y
BR2_SOFT_FLOAT=y
BR2_ARM_INSTRUCTIONS_ARM=y
BR2_TOOLCHAIN_BUILDROOT_CXX=y
BR2_TOOLCHAIN_BUILDROOT_MUSL=y
BR2_REPRODUCIBLE=y
BR2_CCACHE=y
BR2_TARGET_GENERIC_HOSTNAME="rx1950"
BR2_TARGET_GENERIC_ISSUE="rx1950-linux"
BR2_TARGET_GENERIC_GETTY=y
BR2_TARGET_GENERIC_GETTY_PORT="tty1"
BR2_ROOTFS_DEVICE_CREATION_DYNAMIC_EUDEV=y
BR2_TARGET_ENABLE_ROOT_LOGIN=y
BR2_TARGET_GENERIC_ROOT_PASSWD=""
BR2_SYSTEM_BIN_SH_BUSYBOX=y
BR2_TARGET_TZ_INFO=y
BR2_TARGET_TZ_ZONELIST="default"
BR2_TARGET_LOCALTIME="Etc/UTC"
BR2_ROOTFS_OVERLAY="$(BR2_EXTERNAL_RX1950_PATH)/rootfs-overlay"
BR2_ROOTFS_POST_BUILD_SCRIPT="$(BR2_EXTERNAL_RX1950_PATH)/board/hp_rx1950/post-build.sh"
BR2_ROOTFS_POST_BUILD_SCRIPT_ARGS="$(BR2_EXTERNAL_RX1950_PATH)"
BR2_GLOBAL_PATCH_DIR="$(BR2_EXTERNAL_RX1950_PATH)/patches"
BR2_PACKAGE_BUSYBOX_SHOW_OTHERS=y
BR2_PACKAGE_BUSYBOX_CONFIG_FRAGMENT_FILES="$(BR2_EXTERNAL_RX1950_PATH)/configs/busybox.fragment"
BR2_PACKAGE_DROPBEAR=y
BR2_PACKAGE_IPROUTE2=y
BR2_PACKAGE_OPKG=y
BR2_PACKAGE_KMOD=y
BR2_PACKAGE_KMOD_TOOLS=y
BR2_PACKAGE_HTOP=y
BR2_PACKAGE_EVTEST=y
BR2_PACKAGE_I2C_TOOLS=y
BR2_PACKAGE_LM_SENSORS=y
BR2_PACKAGE_LM_SENSORS_SENSORS=y
BR2_PACKAGE_STRACE=y
BR2_PACKAGE_IW=y
BR2_PACKAGE_WPA_SUPPLICANT=y
BR2_PACKAGE_WPA_SUPPLICANT_NL80211=y
BR2_PACKAGE_WPA_SUPPLICANT_CLI=y
BR2_PACKAGE_WPA_SUPPLICANT_PASSPHRASE=y
BR2_PACKAGE_WPA_SUPPLICANT_WEXT=y
BR2_PACKAGE_WPA_SUPPLICANT_CTRL_IFACE=y
BR2_PACKAGE_WIRELESS_TOOLS=y
BR2_PACKAGE_WIRELESS_REGDB=y
BR2_PACKAGE_CA_CERTIFICATES=y
BR2_PACKAGE_OPENSSL=y
BR2_PACKAGE_LIBCURL=y
BR2_PACKAGE_LIBCURL_CURL=y
BR2_PACKAGE_LIBCURL_OPENSSL=y
BR2_PACKAGE_ALSA_UTILS=y
BR2_PACKAGE_ALSA_UTILS_ALSACTL=y
BR2_PACKAGE_ALSA_UTILS_AMIXER=y
BR2_PACKAGE_ALSA_UTILS_APLAY=y
BR2_PACKAGE_ALSA_UTILS_SPEAKER_TEST=y
BR2_PACKAGE_E2FSPROGS=y
BR2_PACKAGE_E2FSPROGS_RESIZE2FS=y
BR2_PACKAGE_UTIL_LINUX_BINARIES=y
BR2_PACKAGE_UTIL_LINUX_PARTX=y
BR2_PACKAGE_XORG7=y
BR2_PACKAGE_XSERVER_XORG_SERVER=y
BR2_PACKAGE_XSERVER_XORG_SERVER_MODULAR=y
BR2_PACKAGE_XDRIVER_XF86_VIDEO_FBDEV=y
BR2_PACKAGE_XDRIVER_XF86_INPUT_EVDEV=y
BR2_PACKAGE_XAPP_XINPUT=y
BR2_PACKAGE_XAPP_XINPUT_CALIBRATOR=y
BR2_PACKAGE_XAPP_XINIT=y
BR2_PACKAGE_MATCHBOX=y
BR2_PACKAGE_MATCHBOX_COMMON=y
BR2_PACKAGE_MATCHBOX_COMMON_PDA=y
BR2_PACKAGE_MATCHBOX_DESKTOP=y
BR2_PACKAGE_MATCHBOX_KEYBOARD=y
BR2_PACKAGE_MATCHBOX_PANEL=y
BR2_PACKAGE_XTERM=y
BR2_PACKAGE_DIALOG=y
BR2_TARGET_ROOTFS_EXT2=y
BR2_TARGET_ROOTFS_EXT2_4=y
BR2_TARGET_ROOTFS_EXT2_LABEL="RX1950ROOT"
BR2_TARGET_ROOTFS_EXT2_SIZE="512M"
BR2_TARGET_ROOTFS_EXT2_MKFS_OPTIONS="-U 19501950-1950-4195-8195-019501950195 -E hash_seed=19501950-1950-4195-8195-019501950195,lazy_itable_init=0,lazy_journal_init=0"
```

## buildroot/external/rx1950/package/gpe-conf-rx1950/Config.in
```kconfig
config BR2_PACKAGE_GPE_CONF_RX1950
	bool "gpe-conf-rx1950"
	depends on BR2_PACKAGE_XORG7
	depends on BR2_USE_WCHAR
	depends on BR2_TOOLCHAIN_HAS_THREADS
	depends on BR2_USE_MMU
	depends on BR2_INSTALL_LIBSTDCPP
	depends on BR2_TOOLCHAIN_HAS_SYNC_4
	select BR2_PACKAGE_LIBGTK2
	help
	  Touch-oriented, on-demand control center for the HP iPAQ rx1950.
	  It retains the extensible applet model of GPE Conf while using the
	  board's current sysfs, ALSA and WEXT helpers. It has no resident
	  process and never installs a setuid executable.
```

## buildroot/external/rx1950/package/jwm/Config.in
```kconfig
config BR2_PACKAGE_JWM
	bool "jwm"
	depends on BR2_PACKAGE_XORG7
	depends on BR2_USE_MMU
	select BR2_PACKAGE_XLIB_LIBX11
	select BR2_PACKAGE_XLIB_LIBXFT
	select BR2_PACKAGE_XLIB_LIBXRENDER
	help
	  Joe's Window Manager is a small, fast X11 window manager with an
	  integrated application menu, task bar and notification area.

	  https://joewing.net/projects/jwm/
```

## buildroot/external/rx1950/package/rx1950-settings/Config.in
```kconfig
config BR2_PACKAGE_RX1950_SETTINGS
	bool "rx1950-settings"
	depends on BR2_PACKAGE_XORG7
	depends on BR2_USE_WCHAR # libglib2
	depends on BR2_TOOLCHAIN_HAS_THREADS # libglib2
	depends on BR2_USE_MMU # libglib2
	depends on BR2_INSTALL_LIBSTDCPP # libgtk2 -> pango
	depends on BR2_TOOLCHAIN_HAS_SYNC_4 # libgtk2 -> pango -> harfbuzz
	select BR2_PACKAGE_LIBGTK2
	help
	  Touch-oriented, on-demand GTK2 control center for rx1950-linux.
	  It configures Wi-Fi, display, sound, JWM appearance, the on-screen
	  keyboard, hardware buttons, power, time and touchscreen calibration.
	  No settings daemon remains resident after the application is closed.
```

## buildroot/external/rx1950/package/rx1950-shell/Config.in
```kconfig
config BR2_PACKAGE_RX1950_SHELL
	bool "rx1950-shell"
	depends on BR2_PACKAGE_XORG7
	depends on BR2_USE_MMU
	select BR2_PACKAGE_XLIB_LIBX11
	help
	  Single-process, Xlib-only window manager, home screen, launcher,
	  task strip and status panel for the HP iPAQ rx1950. It deliberately
	  avoids GTK, Xft, icon themes, D-Bus and resident helpers.
```
